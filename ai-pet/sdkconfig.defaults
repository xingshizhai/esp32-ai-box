## sdkconfig.defaults.esp32s3
```kconfig
CONFIG_ESPTOOLPY_FLASHSIZE_16MB=y
CONFIG_ESPTOOLPY_FLASHMODE_QIO=y

CONFIG_ESP_DEFAULT_CPU_FREQ_MHZ_240=y

CONFIG_SPIRAM=y
CONFIG_SPIRAM_MODE_OCT=y
CONFIG_SPIRAM_SPEED_80M=y
CONFIG_SPIRAM_IGNORE_NOTFOUND=y
CONFIG_SPIRAM_MALLOC_ALWAYSINTERNAL=1024
CONFIG_SPIRAM_TRY_ALLOCATE_WIFI_LWIP=y
CONFIG_SPIRAM_MALLOC_RESERVE_INTERNAL=8192

CONFIG_PARTITION_TABLE_CUSTOM=y
CONFIG_PARTITION_TABLE_CUSTOM_FILENAME="partitions.csv"
CONFIG_PARTITION_TABLE_FILENAME="partitions.csv"

CONFIG_ESP_WIFI_STATIC_RX_BUFFER_NUM=3
CONFIG_ESP_WIFI_DYNAMIC_RX_BUFFER_NUM=6
CONFIG_ESP_WIFI_RX_BA_WIN=3
CONFIG_LWIP_TCPIP_RECVMBOX_SIZE=16
CONFIG_MBEDTLS_DYNAMIC_FREE_CONFIG_DATA=y
# CONFIG_MBEDTLS_INTERNAL_MEM_ALLOC is not set
CONFIG_MBEDTLS_EXTERNAL_MEM_ALLOC=y
CONFIG_MBEDTLS_DYNAMIC_BUFFER=y
CONFIG_MBEDTLS_SSL_IN_CONTENT_LEN=8192
CONFIG_SPIRAM_MALLOC_RESERVE_INTERNAL=16384

CONFIG_ESP32S3_INSTRUCTION_CACHE_32KB=y
CONFIG_ESP32S3_DATA_CACHE_LINE_64B=y

CONFIG_ESP_SYSTEM_EVENT_TASK_STACK_SIZE=4096
CONFIG_ESP_MAIN_TASK_STACK_SIZE=12288

CONFIG_USB_HOST_CONTROL_TRANSFER_MAX_SIZE=1536

CONFIG_STT_PROVIDER_VOLCENGINE=y
# CONFIG_STT_PROVIDER_ALIYUN is not set
# CONFIG_STT_PROVIDER_CUSTOM is not set
CONFIG_VOICE_VOLCENGINE_APP_ID=""
CONFIG_VOICE_VOLCENGINE_ACCESS_TOKEN=""
CONFIG_VOICE_VOLCENGINE_SECRET_KEY=""
CONFIG_VOICE_VOLCENGINE_STT_BASE_URL="wss://openspeech.bytedance.com/api/v3/sauc/bigmodel_async"
CONFIG_VOICE_VOLCENGINE_STT_MODEL="bigmodel"
CONFIG_VOLCENGINE_STT_LANGUAGE="zh-CN"
CONFIG_VOLCENGINE_STT_ENABLE_ITN=y
CONFIG_VOLCENGINE_STT_ENABLE_PUNC=y
# CONFIG_VOLCENGINE_STT_ENABLE_NONSTREAM is not set
CONFIG_VOLCENGINE_STT_RESULT_TYPE="full"
CONFIG_VOLCENGINE_STT_END_WINDOW_SIZE_MS=800

CONFIG_TTS_PROVIDER_VOLCENGINE=y
# CONFIG_TTS_PROVIDER_ALIYUN is not set
# CONFIG_TTS_PROVIDER_CUSTOM is not set
CONFIG_VOICE_VOLCENGINE_TTS_BASE_URL="https://openspeech.bytedance.com/api/v1/tts"
CONFIG_VOICE_VOLCENGINE_TTS_VOICE=""

CONFIG_ENABLE_VOICE_GATEWAY=y
CONFIG_DEFAULT_VOICE_GATEWAY_URL="http://192.168.1.101:8787"
CONFIG_DEFAULT_VOICE_GATEWAY_TOKEN=""

CONFIG_ENABLE_BARGE_IN=y
CONFIG_VAD_SILENCE_MS=800
CONFIG_STT_TIMEOUT_MS=8000
CONFIG_TTS_TIMEOUT_MS=12000
CONFIG_AUDIO_CHUNK_MS=200
```

## sdkconfig.defaults.esp32s3_box3
```kconfig
# ESP32-S3-BOX-3 board-owned audio routing.
CONFIG_AUDIO_I2S_MCLK_GPIO=2
CONFIG_AUDIO_I2S_BCLK_GPIO=17
CONFIG_AUDIO_I2S_WS_GPIO=45
CONFIG_AUDIO_I2S_DOUT_GPIO=15
CONFIG_AUDIO_I2S_DIN_GPIO=16
CONFIG_AUDIO_CODEC_I2C_PORT=1
CONFIG_AUDIO_CODEC_I2C_SCL_GPIO=18
CONFIG_AUDIO_CODEC_I2C_SDA_GPIO=8
CONFIG_AUDIO_ES8311_I2C_ADDR=0x18
CONFIG_AUDIO_ES7210_I2C_ADDR=0x40
CONFIG_AUDIO_PA_GPIO=46
# CONFIG_AUDIO_PA_INVERTED is not set
```

## sdkconfig.defaults.role.ai_pet
```kconfig
CONFIG_APP_ROLE_AI_PET=y
# CONFIG_APP_ROLE_ANTI_AI_PET is not set
CONFIG_SR_WN_WN9_NIHAOXIAOZHI_TTS=y
```
